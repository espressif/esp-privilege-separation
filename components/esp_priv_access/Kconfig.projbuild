## components/esp_priv_access/Kconfig.projbuild
```kconfig
menu "Privilege separation"

    menu "Memory allocation"

    config PA_ALLOCATE_USER_IRAM_SIZE
        hex "Allocate IRAM space for user application"
        range 0 0x10000
        default 0x800
        help
            Allocate IRAM for user space application. This size will reflect in the user_app as well.
            This is the size of IRAM that would be dedicated for user space code.

    choice PA_MEMORY_ALLOCATION_POLICY
        prompt "Memory allocation policy"
        default PA_MEMORY_ALLOCATE_USER
        help
            Choose the DRAM memory allocation policy.
            Either allocate DRAM memory for protected app or for user app. The size configured by PA_ALLOCATE_DRAM_SIZE will be
            allocated to the chosen execution environment and the remaining DRAM memory will be allocated
            to the other execution environment.

        config PA_MEMORY_ALLOCATE_PROTECTED
            bool "Allocate to protected app"

        config PA_MEMORY_ALLOCATE_USER
            bool "Allocate to user app"
    endchoice

    config PA_ALLOCATE_DRAM_SIZE
        hex "Allocate DRAM space for chosen execution environment"
        range 0 0x40000
        default 0x19000
        help
            Allocate DRAM for the chosen execution environment (i.e protected or user)

            This DRAM size is for data, bss and heap memory combined.
    endmenu

    choice PA_VIOLATION_POLICY
        prompt "User app violation policy"
        default PA_REBOOT_ENTIRE_SYSTEM
        help
            Policy for handling permission violation of user task. In case any user task violates
            its permission, handle the exception as per the policy selected

        config PA_DELETE_VIOLATING_TASK
            bool "Delete only the violating user task"
        config PA_RESTART_USER_APP
            bool "Restart user app (EXPERIMENTAL)"
            help
                When enabled, restart the user app without restarting the protected app.
                When exception occurs in user space, the panic handler will delete
                all the user space tasks and reboot user app

                Note: This is still in experimental stage and there are few things that need to be addressed.
                      One being heap cleanup and another being peripheral resources cleanup
        config PA_REBOOT_ENTIRE_SYSTEM
            bool "Reboot entire system (protected + user)"
    endchoice

    config PA_PROTECTED_TASK_WDT_PANIC
        bool "Panic on task watchdog timeout in protected space"
        depends on ESP_TASK_WDT && !ESP_TASK_WDT_PANIC
        default n
        help
            Invoke panic handler when task watchdog timeout occurs in any protected space task.
            The entire system (protected + user) would be restarted

    config PA_USER_TASK_WDT_PANIC
        bool "Panic on task watchdog timeout in user space"
        depends on ESP_TASK_WDT && !ESP_TASK_WDT_PANIC
        default y
        help
            Invoke panic handler when task watchdog timeout occurs in any user space task.
            The panic behavior will be as per the violation policy set above

    config PA_BACKTRACE_INFO
        bool "Print violating task backtrace info"
        default y
        help
            If enabled, registers and stack dump of the violating user task will be printed on the console
            This information can be further used by host utility (e.g idf_monitor) to generate a backtrace

    config PA_CONSOLE_ENABLE
        bool "Enable serial console"
        default y
        help
            Enable serial debug console.

    config PA_KERNEL_STACK_SIZE
        int "Kernel stack size"
        range 2560 20480
        default 2560
        help
            Set the kernel stack size.
            Each user space task has its own kernel stack. Kernel stack is used while processing system calls.

    config PA_USER_MAIN_TASK_STACK_SIZE
        int "User main task stack size"
        default 3584
        help
            Set the user main task stack size.
            This is stack of the task that calls user_main().

    config PA_USER_DISPATCHER_TASK_STACK_SIZE
        int "User dispatcher task stack size"
        default 2048
        help
            Set the user dispatcher task stack size.
            All the user registered ISRs and event handlers will be executed from this task's context

endmenu
```

## components/esp_ps/Kconfig
```kconfig
menu "Privilege separation"

    menu "Memory allocation"

    config PS_ALLOCATE_USER_IRAM_SIZE
        hex "Allocate IRAM space for user application"
        range 0 0x10000
        default 0x800
        help
            Allocate IRAM for user space application. This size will reflect in the user_app as well.
            This is the size of IRAM that would be dedicated for user space code.

    choice PS_MEMORY_ALLOCATION_POLICY
        prompt "Memory allocation policy"
        default PS_MEMORY_ALLOCATE_USER
        help
            Choose the DRAM memory allocation policy.
            Either allocate DRAM memory for protected app or for user app. The size configured by PS_ALLOCATE_DRAM_SIZE will be
            allocated to the chosen execution environment and the remaining DRAM memory will be allocated
            to the other execution environment.

        config PS_MEMORY_ALLOCATE_PROTECTED
            bool "Allocate to protected app"

        config PS_MEMORY_ALLOCATE_USER
            bool "Allocate to user app"
    endchoice

    config PS_ALLOCATE_DRAM_SIZE
        hex "Allocate DRAM space for chosen execution environment"
        range 0 0x40000
        default 0x19000
        help
            Allocate DRAM for the chosen execution environment (i.e protected or user)

            This DRAM size is for data, bss and heap memory combined.
    endmenu

    choice PS_VIOLATION_POLICY
        prompt "User app violation policy"
        default PS_RESTART_USER_APP
        help
            Policy for handling permission violation of user task. In case any user task violates
            its permission, handle the exception as per the policy selected

        config PS_DELETE_VIOLATING_TASK
            bool "Delete only the violating user task"
        config PS_RESTART_USER_APP
            bool "Restart user app"
        config PS_REBOOT_ENTIRE_SYSTEM
            bool "Reboot entire system (protected + user)"
    endchoice

    config PS_BACKTRACE_INFO
        bool "Print violating task backtrace info"
        default y
        help
            If enabled, registers and stack dump of the violating user task will be printed on the console
            This information can be further used by host utility (e.g idf_monitor) to generate a backtrace

endmenu
```

## components/esp_syscall/Kconfig
```kconfig
menu "ESP Syscall"

    config ESP_SYSCALL_VERIFY_RETURNED_POINTERS
    bool "Verify that raw kernel pointers are not returned to user app"
    default n
    help
        Protected app implements shim layer to wrap raw pointers.
        Enable this config to verify that a raw kernel pointer is not returned to user space.

endmenu
```

## components/protected/esp_priv_access/Kconfig.projbuild
```kconfig
menu "Privilege Separation"

    menu "Security features"

    config PA_ENABLE_USER_APP_SECURE_BOOT
        bool "Enable user app secure boot"
        default n
        help
            If this option is set, protected application will verify whether the user app is signed by a trusted source.
            For more details, refer to Secure boot section in the documentation

    config PA_CA_CERT_FILE
        string "Protected app CA certificate file"
        depends on PA_ENABLE_USER_APP_SECURE_BOOT
        default "protected_ca_cert.pem"
        help
            This is the CA certificate that will be embedded inside the protected application. This CA will be used
            to verify the user application by verifying the digital signature appended to user application.

    endmenu

    menu "Memory allocation"

    config PA_ALLOCATE_USER_IRAM_SIZE
        hex "Allocate IRAM space for user application"
        range 0 0x10000 if IDF_TARGET_ESP32C3
        range 0 0x3000 if (IDF_TARGET_ESP32S3 && ESP32S3_INSTRUCTION_CACHE_16KB)
        range 0 0x1F400 if (IDF_TARGET_ESP32S3 && ESP32S3_INSTRUCTION_CACHE_32KB)
        default 0x800
        help
            Allocate IRAM for user space application. This size will reflect in the user_app as well.
            This is the size of IRAM that would be dedicated for user space code.

    choice PA_MEMORY_ALLOCATION_POLICY
        prompt "Memory allocation policy"
        default PA_MEMORY_ALLOCATE_USER
        help
            Choose the DRAM memory allocation policy.
            Either allocate DRAM memory for protected app or for user app. The size configured by PA_ALLOCATE_DRAM_SIZE will be
            allocated to the chosen execution environment and the remaining DRAM memory will be allocated
            to the other execution environment.

        config PA_MEMORY_ALLOCATE_PROTECTED
            bool "Allocate to protected app"

        config PA_MEMORY_ALLOCATE_USER
            bool "Allocate to user app"
    endchoice

    config PA_ALLOCATE_DRAM_SIZE
        hex "Allocate DRAM space for chosen execution environment"
        range 0 0x40000
        default 0x19000
        help
            Allocate DRAM for the chosen execution environment (i.e protected or user)

            This DRAM size is for data, bss and heap memory combined.
    endmenu

    choice PA_VIOLATION_POLICY
        prompt "User app violation policy"
        default PA_REBOOT_ENTIRE_SYSTEM
        help
            Policy for handling permission violation of user task. In case any user task violates
            its permission, handle the exception as per the policy selected

        config PA_DELETE_VIOLATING_TASK
            bool "Delete only the violating user task"
        config PA_RESTART_USER_APP
            bool "Restart user app (EXPERIMENTAL)"
            help
                When enabled, restart the user app without restarting the protected app.
                When exception occurs in user space, the panic handler will delete
                all the user space tasks and reboot user app

                Note: This is still in experimental stage and there are few things that need to be addressed.
                      One being heap cleanup and another being peripheral resources cleanup
        config PA_REBOOT_ENTIRE_SYSTEM
            bool "Reboot entire system (protected + user)"
    endchoice

    config PA_PROTECTED_TASK_WDT_PANIC
        bool "Panic on task watchdog timeout in protected space"
        depends on ESP_TASK_WDT && !ESP_TASK_WDT_PANIC
        default n
        help
            Invoke panic handler when task watchdog timeout occurs in any protected space task.
            The entire system (protected + user) would be restarted

    config PA_USER_TASK_WDT_PANIC
        bool "Panic on task watchdog timeout in user space"
        depends on ESP_TASK_WDT && !ESP_TASK_WDT_PANIC
        default y
        help
            Invoke panic handler when task watchdog timeout occurs in any user space task.
            The panic behavior will be as per the violation policy set above

    config PA_BACKTRACE_INFO
        bool "Print violating task backtrace info"
        default y
        help
            If enabled, registers and stack dump of the violating user task will be printed on the console
            This information can be further used by host utility (e.g idf_monitor) to generate a backtrace

    config PA_CONSOLE_ENABLE
        bool "Enable serial console"
        default y
        help
            Enable serial debug console.

    config PA_KERNEL_STACK_SIZE
        int "Kernel stack size"
        range 2560 20480
        default 2560
        help
            Set the kernel stack size.
            Each user space task has its own kernel stack. Kernel stack is used while processing system calls.

    config PA_USER_MAIN_TASK_STACK_SIZE
        int "User main task stack size"
        default 3584
        help
            Set the user main task stack size.
            This is stack of the task that calls user_main().

    config PA_USER_DISPATCHER_TASK_STACK_SIZE
        int "User dispatcher task stack size"
        default 2048
        help
            Set the user dispatcher task stack size.
            All the user registered ISRs and event handlers will be executed from this task's context

    config PA_ENABLE_USER_APP_ROLLBACK
        bool "Enable user app rollback"
        default n
        help
            Enable user app rollback after performing OTA upgrade.

endmenu
```

## components/protected/esp_user_ota/Kconfig
```kconfig
menu "ESP User OTA"

    config ESP_USER_OTA_SKIP_VERSION_CHECK
        bool "Skip firmware version check"
        default n
        help
            This allows you to skip the firmware version check.

endmenu
```

## examples/blink/sdkconfig.defaults
```kconfig
CONFIG_IDF_CMAKE=y

CONFIG_PARTITION_TABLE_CUSTOM=y
CONFIG_PARTITION_TABLE_CUSTOM_FILENAME="partitions.csv"

CONFIG_FREERTOS_UNICORE=y
CONFIG_FREERTOS_TASK_FUNCTION_WRAPPER=n
CONFIG_FREERTOS_THREAD_LOCAL_STORAGE_POINTERS=5
CONFIG_FREERTOS_SUPPORT_STATIC_ALLOCATION=y
CONFIG_FREERTOS_ENABLE_STATIC_TASK_CLEAN_UP=y
CONFIG_FREERTOS_PLACE_FUNCTIONS_INTO_FLASH=y

CONFIG_ESP_INT_WDT=y
# Printing debug information on crash causes interrupt WDT to trigger hence a larger timeout.
CONFIG_ESP_INT_WDT_TIMEOUT_MS=1000
CONFIG_ESP_TASK_WDT=y

CONFIG_ESP_SYSTEM_MEMPROT_FEATURE=n
CONFIG_ESP_SYSTEM_MEMPROT_FEATURE_LOCK=n

CONFIG_NEWLIB_NANO_FORMAT=y

CONFIG_ESP_PRIVILEGE_SEPARATION_ENABLE=y
```

## examples/esp_http_client/sdkconfig.defaults
```kconfig
CONFIG_IDF_CMAKE=y
CONFIG_IDF_TARGET_ARCH_RISCV=y
CONFIG_IDF_TARGET="esp32c3"
CONFIG_IDF_TARGET_ESP32C3=y

CONFIG_PARTITION_TABLE_CUSTOM=y
CONFIG_PARTITION_TABLE_CUSTOM_FILENAME="partitions.csv"

CONFIG_FREERTOS_UNICORE=y
CONFIG_FREERTOS_TASK_FUNCTION_WRAPPER=n
CONFIG_FREERTOS_THREAD_LOCAL_STORAGE_POINTERS=4
CONFIG_FREERTOS_SUPPORT_STATIC_ALLOCATION=y
CONFIG_FREERTOS_ENABLE_STATIC_TASK_CLEAN_UP=y
CONFIG_FREERTOS_PLACE_FUNCTIONS_INTO_FLASH=y

CONFIG_ESP_INT_WDT=y
# Printing debug information on crash causes interrupt WDT to trigger hence a larger timeout.
CONFIG_ESP_INT_WDT_TIMEOUT_MS=1000
CONFIG_ESP_TASK_WDT=y

CONFIG_ESP_SYSTEM_MEMPROT_FEATURE=n
CONFIG_ESP_SYSTEM_MEMPROT_FEATURE_LOCK=n

CONFIG_NEWLIB_NANO_FORMAT=y

CONFIG_ESP_PRIVILEGE_SEPARATION_ENABLE=y
CONFIG_ESP_TLS_USE_DS_PERIPHERAL=n

CONFIG_MBEDTLS_DYNAMIC_BUFFER=y
CONFIG_MBEDTLS_DYNAMIC_FREE_PEER_CERT=y
CONFIG_MBEDTLS_DYNAMIC_FREE_CONFIG_DATA=y
CONFIG_MBEDTLS_DYNAMIC_FREE_CA_CERT=y

# Disable hardware accelerators
CONFIG_MBEDTLS_HARDWARE_AES=n
CONFIG_MBEDTLS_HARDWARE_MPI=n
CONFIG_MBEDTLS_HARDWARE_SHA=n
```

## examples/http_request/sdkconfig.defaults
```kconfig
CONFIG_IDF_CMAKE=y
CONFIG_IDF_TARGET_ARCH_RISCV=y
CONFIG_IDF_TARGET="esp32c3"
CONFIG_IDF_TARGET_ESP32C3=y

CONFIG_ESP32C3_REV_MIN_0=y
CONFIG_ESP32C3_REV_MIN=0

CONFIG_PARTITION_TABLE_CUSTOM=y
CONFIG_PARTITION_TABLE_CUSTOM_FILENAME="partitions.csv"

CONFIG_FREERTOS_UNICORE=y
CONFIG_FREERTOS_TASK_FUNCTION_WRAPPER=n
CONFIG_FREERTOS_THREAD_LOCAL_STORAGE_POINTERS=3
CONFIG_FREERTOS_SUPPORT_STATIC_ALLOCATION=y
CONFIG_FREERTOS_ENABLE_STATIC_TASK_CLEAN_UP=y

CONFIG_ESP_INT_WDT=y
CONFIG_ESP_TASK_WDT=y

CONFIG_ESP_SYSTEM_MEMPROT_FEATURE=n
CONFIG_ESP_SYSTEM_MEMPROT_FEATURE_LOCK=n

CONFIG_NEWLIB_NANO_FORMAT=y

CONFIG_ESP_PRIVILEGE_SEPARATION_ENABLE=y
```
